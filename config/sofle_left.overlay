/ { 
  behaviors { 
    encoder_mmv_x: encoder_mmv_x { 
      compatible = "zmk,behavior-sensor-rotate"; 
      label = "ENCODER_MMV_X"; 
      #binding-cells = <0>; 
      bindings = < 
        &mmv 10 0, 
        &mmv -10 0 
      >; 
    }; 
      encoder_mmv_y: encoder_mmv_y {
      compatible = "zmk,behavior-sensor-rotate"; 
      label = "ENCODER_MMV_Y"; 
      #binding-cells = <0>; 
      bindings = <
          &mmv 0 -10,
          &mmv 0 10 
      >;
    }; 
  }; 
};
